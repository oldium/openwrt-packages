## net/sniproxy/Config.in
```kconfig
menu "Configuration"
	depends on PACKAGE_sniproxy

config SNIPROXY_WITH_UDNS
	bool
	default y
	select libudns
	prompt "Enable hostname or wildcard entries resolution by UDNS"

endmenu
```
